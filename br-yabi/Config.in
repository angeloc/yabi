## br-yabi/Config.in
```kconfig
source "$BR2_EXTERNAL_YABI_PATH/package/fbv-ng/Config.in"
source "$BR2_EXTERNAL_YABI_PATH/package/yabi/Config.in"
```

## br-yabi/configs/arietta_xterm01_yabi_defconfig
```kconfig
BR2_arm=y
BR2_TOOLCHAIN_EXTERNAL=y
BR2_TOOLCHAIN_EXTERNAL_BOOTLIN_ARMV5_EABI_GLIBC_STABLE=y
BR2_GLOBAL_PATCH_DIR="$(BR2_EXTERNAL_YABI_PATH)/board/arietta-xterm01/patches"
BR2_DOWNLOAD_FORCE_CHECK_HASHES=y
BR2_TARGET_GENERIC_HOSTNAME="arietta"
BR2_TARGET_GENERIC_ISSUE="Welcome to the yabi demo on the Arietta G25 + XTERM-01"
BR2_TARGET_GENERIC_GETTY_PORT="ttyS0"
BR2_ROOTFS_OVERLAY="$(BR2_EXTERNAL_YABI_PATH)/board/arietta-xterm01/rootfs-overlay"
BR2_ROOTFS_POST_IMAGE_SCRIPT="support/scripts/genimage.sh"
BR2_ROOTFS_POST_SCRIPT_ARGS="-c $(BR2_EXTERNAL_YABI_PATH)/board/arietta-xterm01/genimage.cfg"
BR2_LINUX_KERNEL=y
BR2_LINUX_KERNEL_CUSTOM_VERSION=y
BR2_LINUX_KERNEL_CUSTOM_VERSION_VALUE="6.18.63"
BR2_LINUX_KERNEL_DEFCONFIG="at91_dt"
BR2_LINUX_KERNEL_CONFIG_FRAGMENT_FILES="$(BR2_EXTERNAL_YABI_PATH)/board/arietta-xterm01/linux.fragment"
BR2_LINUX_KERNEL_DTS_SUPPORT=y
BR2_LINUX_KERNEL_CUSTOM_DTS_PATH="$(BR2_EXTERNAL_YABI_PATH)/board/arietta-xterm01/at91-ariettag25-xterm01.dts"
BR2_LINUX_KERNEL_NEEDS_HOST_OPENSSL=y
BR2_PACKAGE_YABI=y
BR2_PACKAGE_YABI_DEMO=y
BR2_TARGET_ROOTFS_EXT2=y
BR2_TARGET_ROOTFS_EXT2_4=y
BR2_TARGET_ROOTFS_EXT2_SIZE="64M"
# BR2_TARGET_ROOTFS_TAR is not set
BR2_TARGET_AT91BOOTSTRAP3=y
BR2_TARGET_AT91BOOTSTRAP3_LATEST_VERSION_3X=y
BR2_TARGET_AT91BOOTSTRAP3_DEFCONFIG="arietta-128m"
BR2_PACKAGE_HOST_DOSFSTOOLS=y
BR2_PACKAGE_HOST_GENIMAGE=y
BR2_PACKAGE_HOST_MTOOLS=y
```

## br-yabi/package/fbv-ng/Config.in
```kconfig
config BR2_PACKAGE_FBV_NG
	bool "fbv-ng"
	depends on BR2_INSTALL_LIBSTDCPP
	depends on BR2_TOOLCHAIN_GCC_AT_LEAST_10 # C++20
	depends on !BR2_PACKAGE_FBV # both install /usr/bin/fbv
	help
	  Framebuffer image viewer, a C++20 rewrite of fbv with
	  animated GIFs and a control socket. BMP is built in; PNG,
	  JPEG and GIF support follow libpng, jpeg and giflib.

	  https://github.com/angeloc/fbv-ng

comment "fbv-ng needs a toolchain w/ C++, gcc >= 10"
	depends on !BR2_INSTALL_LIBSTDCPP || !BR2_TOOLCHAIN_GCC_AT_LEAST_10
```

## br-yabi/package/yabi/Config.in
```kconfig
config BR2_PACKAGE_YABI
	bool "yabi"
	depends on BR2_INSTALL_LIBSTDCPP
	depends on BR2_TOOLCHAIN_GCC_AT_LEAST_10 # C++20
	depends on !BR2_PACKAGE_FBV # fbv-ng
	select BR2_PACKAGE_FBV_NG
	select BR2_PACKAGE_GIFLIB # the themes are GIF animations
	help
	  Yet another bootsplash implementation: a boot splash on the
	  framebuffer that shows fbv-ng animations and follows the
	  boot. With busybox or SysV init it installs S00yabi and
	  S98yabi; with systemd, its units.

	  https://github.com/angeloc/yabi

if BR2_PACKAGE_YABI

config BR2_PACKAGE_YABI_DEMO
	bool "demo application"
	depends on BR2_INIT_BUSYBOX || BR2_INIT_SYSV
	help
	  Install the application of the yabi demo, started at the end
	  of the boot, which takes the screen over from the splash.

endif

comment "yabi needs a toolchain w/ C++, gcc >= 10"
	depends on !BR2_INSTALL_LIBSTDCPP || !BR2_TOOLCHAIN_GCC_AT_LEAST_10
```
